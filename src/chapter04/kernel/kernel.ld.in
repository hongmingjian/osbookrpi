#define LOADADDR 0x8000
#define KERNBASE 0xC0000000

OUTPUT_FORMAT("elf32-littlearm")
OUTPUT_ARCH(arm)

ENTRY(_entry)
SECTIONS {
  . = LOADADDR+KERNBASE;
  .text : {
    *(.text)
  }

  . = ALIGN(4);
  .rodata : {
    *(.rodata)
  }
  .rdata : {
    *(.rdata)
  }
  .data : {
    *(.data)
  }
  . = ALIGN(4);
  _edata = .;

  .bss : {
    *(.bss)
    *(COMMON)
  }

  . = ALIGN(4);
  _end = .;
}
